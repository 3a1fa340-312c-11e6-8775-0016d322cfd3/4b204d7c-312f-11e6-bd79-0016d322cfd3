; -----------------------------------------------------------------------------------
; Select the device prompt
; -----------------------------------------------------------------------------------
 B::

; -----------------------------------------------------------------------------------
; Clear the TRACE32 screen
; -----------------------------------------------------------------------------------
 WinClear

; -----------------------------------------------------------------------------------
; Select the target CPU, endian mode, and reset the targer
; -----------------------------------------------------------------------------------
 SYStem.CPU FA526

 SYStem.Option BigEndian OFF

 SYStem.Option EnReset ON

; -----------------------------------------------------------------------------------
; Inform the ICD about read-only address range (flash)
; -----------------------------------------------------------------------------------
; Map.BOnchip 0x10000000++0x0FFFFFFF


; -----------------------------------------------------------------------------------
; Restart the CPU with the debug mode enabled
; -----------------------------------------------------------------------------------
 SYStem.UP

; -----------------------------------------------------------------------------------
; Configure and open semihosting channel
; -----------------------------------------------------------------------------------
 TrOnchip.Set SWI ON

 Winpos 50% 50% 50% 50%

 Term.HeapInfo 0 0x20000 0x30000 0x20000

 Term.Method ARMSWI

 Term.Mode STRING

 Term.Gate


; -----------------------------------------------------------------------------------
; Configure PC counter and Stack pointer
; -----------------------------------------------------------------------------------
 Register.Set pc 0x8000

 Register.Set r13 0x20700000


; -----------------------------------------------------------------------------------
; Setting for DDR Controller 16-bit mode
; -----------------------------------------------------------------------------------

; DDRC: 16-bit mode, SDRAM Module: 256Mb * 16, Little-Endian
; -----------------------------------------------------------------------------------
 Data.Set SD:0x72000000 %LONG 0x02000021

; Configuration of Parameter Configure Register
; -----------------------------------------------------------------------------------
; Enable DLL of DDR Device (for Silicon platform)
 Data.Set SD:0x72000004 %LONG 0x00000020

; Configuration of Timing Parameter 0 Register
; -----------------------------------------------------------------------------------
 Data.Set SD:0x72000010 %LONG 0x32292A62

; Configuration of Timing Parameter 1 Register
; -----------------------------------------------------------------------------------
 Data.Set SD:0x72000014 %LONG 0x140F10C8

; Configuration of Timing Parameter 2 Register
; -----------------------------------------------------------------------------------
; Configuration of Timing Parameter 2 Register (for 87.5MHz AHB, Silicon platform)
 Data.Set SD:0x72000018 %LONG 0x00070029


; Configuration of Power-Up Control Register
; -----------------------------------------------------------------------------------
 Data.Set SD:0x72000008 %LONG 0x00000001

; -----------------------------------------------------------------------------------
; Need to wait until InitCmp bit @0x72000008 becomes 1
; -----------------------------------------------------------------------------------

; Configuration of Preread Enable Register
; -----------------------------------------------------------------------------------
; Data.Set SD:0x72000020 %LONG 0x000000FF

; Configuration of DDQ Output Delay Control Register (Silicon Only)
; -----------------------------------------------------------------------------------
; Data.Set SD:0x72000030 %LONG 0x00000044

; Configuration of DQS Input Delay Control Register (Silicon Only)
; -----------------------------------------------------------------------------------
; Data.Set SD:0x72000034 %LONG 0x04040404

; Configuration of HCLK Delay Control Register (Silicon Only)
; -----------------------------------------------------------------------------------
; Data.Set SD:0x72000038 %LONG 0x00000007


; -----------------------------------------------------------------------------------
; perform memory remap
 Data.Set SD:0x76000000 %LONG 0x1


; -----------------------------------------------------------------------------------
; set SMC's Flash Bank 0 config register as follows: 
; bank 0 enable, bank data width = 8Bit, disable write protect
 Data.Set SD:0x73000000 %LONG 0x00000002


; -----------------------------------------------------------------------------------

; -----------------------------------------------------------------------------------
; 1. Exit(Disable) PLL Power Down
; 2. Disable AHB and APB Clock Mask
; 3. Exit Power On Reset State
; -----------------------------------------------------------------------------------
 Data.Set SD:0x77000010 %LONG 0x0
 Data.Set SD:0x77000000 %LONG 0xFFFFFFFF
 Data.Set SD:0x77000004 %LONG 0xFFFFFFFF
 Data.Set SD:0x77000008 %LONG 0xFFFFFFFF
; -----------------------------------------------------------------------------------

; -----------------------------------------------------------------------------------
; Configure Regulator register
; Set pd_25 = 0, and sel_sdr = 0 for Str8182 (not using SDR and MII interface simultaneously)
; -----------------------------------------------------------------------------------
 Data.Set SD:0x77000024 %LONG 0x00130723


; -----------------------------------------------------------------------------------
; Configure Regulator register
; Set pd_25 = 1, and sel_sdr = 1 for Str8133 (using SDR and MII interface simultaneously)
; -----------------------------------------------------------------------------------
; Data.Set SD:0x77000024 %Long 0x00133723


; -----------------------------------------------------------------------------------
; -----------------------------------------------------------------------------------
 Data.List

 Register /SpotLight

ENDDO










