 B::
 WinClear
 SYStem.CPU FA526
 SYStem.Option BigEndian OFF
 SYStem.Option EnReset ON
 SYStem.UP 
 TrOnchip.Set SWI ON
 Term.HeapInfo 0 0x20000 0x30000 0x20000
 Term.Method ARMSWI
 Term.Mode STRING
 Term.Gate

 D.S SD:0x7A00000C %LE %LONG 0x0		;watch dog
 D.S SD:0x71000040 %LE %LONG 0x40000000	;SPI
 D.S SD:0x71000048 %LE %LONG 0x1		;SPI

 D.S SD:0x73000000 %LE %LONG 0x00000002
 D.S SD:0x73000004 %LE %LONG 0x330F0F0F

 D.S SD:0x77000010 %LE %LONG 0x50 		;Disable I2S,USB Device
 D.S SD:0x77000000 %LE %LONG 0x01F01033	;Disable PCI,DMA,IDE;Enable USB, MAC, VIC, DRAM, Static Memory
 D.S SD:0x77000004 %LE %LONG 0x02021003
 D.S SD:0x77000008 %LE %LONG 0xFFFFFFFF	;All reset

 D.S SD:0x77000024 %LE %LONG 0x00130723
 D.S SD:0x72000000 %LE %LONG 0x02000020	;DDR 128MB 
 D.S SD:0x72000004 %LE %LONG 0x00000022 
 D.S SD:0x72000010 %LE %LONG 0x32292A62  
 D.S SD:0x72000014 %LE %LONG 0x140F10C8 
 D.S SD:0x72000018 %LE %LONG 0x00080078 
 D.S SD:0x72000008 %LE %LONG 0x00000001 
 D.S SD:0x7200001C %LE %LONG 0x00000080 
 D.S SD:0x72000020 %LE %LONG 0x000000FF
 D.S SD:0x72000030 %LE %LONG 0x00000022
 D.S SD:0x72000034 %LE %LONG 0x00330033 

 D.S SD:0x76000000 %LE %LONG 0x1 		;re-map

 REGISTER.RESET
 d.load.elf Z:\ZOT716U2W_SDK_0.01\zotdwp2020.axf /spath /lpath
 ;d.load.elf Z:\ZOT716U2W_SDK_0.01\prod\zotdwp2020\build\zotdwp2020.axf /spath /lpath

print "Finished!!"

	y.spath + C:\ecos-1.3.1\packages\hal\arm\arch\v1_3_1\src
	;y.spath + C:\ecos-1.3.1\packages\hal\arm\zotdwp2020\v1_3_1\src 
    y.spath + Z:\ZOT716U2W_SDK_0.01\prod\zotdwp2020\build
    y.spath + Z:\ZOT716U2W_SDK_0.01\apps\mac
    y.spath + Z:\ZOT716U2W_SDK_0.01\apps\ps\common\src
    y.spath + Z:\ZOT716U2W_SDK_0.01\apps\ps\ntps\src
    y.spath + Z:\ZOT716U2W_SDK_0.01\apps\spooler\src
    y.spath + Z:\ZOT716U2W_SDK_0.01\apps\ipxbeui
    y.spath + Z:\ZOT716U2W_SDK_0.01\apps\usb_host\src
    y.spath + Z:\ZOT716U2W_SDK_0.01\apps\http_zot\src
    y.spath + Z:\ZOT716U2W_SDK_0.01\apps\http_zot\incl
    y.spath + Z:\ZOT716U2W_SDK_0.01\apps\ps\ippd\src
    y.spath + Z:\ZOT716U2W_SDK_0.01\apps\ps\ippd\incl
    y.spath + Z:\ZOT716U2W_SDK_0.01\apps\ps\lpd\src
    y.spath + Z:\ZOT716U2W_SDK_0.01\apps\ps\lpd\incl
    y.spath + Z:\ZOT716U2W_SDK_0.01\apps\ps\smbd\src
    y.spath + Z:\ZOT716U2W_SDK_0.01\apps\ps\smbd\incl
    y.spath + Z:\ZOT716U2W_SDK_0.01\apps\ps\novell\src
    y.spath + Z:\ZOT716U2W_SDK_0.01\apps\ps\novell\incl
    y.spath + Z:\ZOT716U2W_SDK_0.01\apps\ps\psutility
    y.spath + Z:\ZOT716U2W_SDK_0.01\apps\snmp\src
    y.spath + Z:\ZOT716U2W_SDK_0.01\apps\snmp\incl
    y.spath + Z:\ZOT716U2W_SDK_0.01\apps\ps\rawtcpd
    y.spath + Z:\ZOT716U2W_SDK_0.01\apps\ps\atalk\src
    y.spath + Z:\ZOT716U2W_SDK_0.01\apps\rendezvous\src
    y.spath + Z:\ZOT716U2W_SDK_0.01\apps\ps\tftp_zot\src
    y.spath + Z:\ZOT716U2W_SDK_0.01\apps\mtk7601\src
    y.spath + Z:\ZOT716U2W_SDK_0.01\apps\mtk7601\incl
    y.spath + Z:\ZOT716U2W_SDK_0.01\apps\realtek\src\wpa_supplicant
    y.spath + Z:\ZOT716U2W_SDK_0.01\apps\ps\telnet\src
    y.spath + Z:\ZOT716U2W_SDK_0.01\apps\uart\
	
    y.spath + Z:\ZOT716U2W_SDK_0.01\apps\tcpip\src
    y.spath + Z:\ZOT716U2W_SDK_0.01\apps\tcpip\incl

 winpos 0% 0% 100% 50%
 w.d.l
 winpos 0% 50% 50% 50%
 w.v.f /l /c
 winpos 50% 50% 50% 50%
 w.v.w flags ast

 enddo















